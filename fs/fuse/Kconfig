## fs/fuse/Kconfig
```kconfig
# SPDX-License-Identifier: GPL-2.0-only
config FUSE_FS
	tristate "FUSE (Filesystem in Userspace) support"
	select FS_POSIX_ACL
	help
	  With FUSE it is possible to implement a fully functional filesystem
	  in a userspace program.

	  There's also a companion library: libfuse2.  This library is available
	  from the FUSE homepage:
	  <https://github.com/libfuse/>
	  although chances are your distribution already has that library
	  installed if you've installed the "fuse" package itself.

	  See <file:Documentation/filesystems/fuse.rst> for more information.
	  See <file:Documentation/Changes> for needed library/utility version.

	  If you want to develop a userspace FS, or if you want to use
	  a filesystem based on FUSE, answer Y or M.

config CUSE
	tristate "Character device in Userspace support"
	depends on FUSE_FS
	help
	  This FUSE extension allows character devices to be
	  implemented in userspace.

	  If you want to develop or use a userspace character device
	  based on CUSE, answer Y or M.

# 开启后 虚拟机中有了 fuse 的client, 用于访问 qemu host 提供的 virtio 文件系统
# 需要宿主机运行 virtiofsd, 使用 qemu的 vhost-user-fs-pci 将共享目录传递给虚拟机
config VIRTIO_FS
	tristate "Virtio Filesystem"
	depends on FUSE_FS
	select VIRTIO
	help
	  The Virtio Filesystem allows guests to mount file systems from the
	  host.

	  If you want to share files between guests or with the host, answer Y
	  or M.
# 配合 virtio fs 使用的, 依赖 VIRTIO_FS
config FUSE_DAX
	bool "Virtio Filesystem Direct Host Memory Access support"
	default y
	select INTERVAL_TREE
	depends on VIRTIO_FS
	depends on FS_DAX
	depends on DAX
	help
	  This allows bypassing guest page cache and allows mapping host page
	  cache directly in guest address space.

	  If you want to allow mounting a Virtio Filesystem with the "dax"
	  option, answer Y.
```

## mm/kwatch/Kconfig
```kconfig
config KWATCH
	bool "Kernel Watch Framework"
	depends on HAVE_HW_BREAKPOINT
	depends on HAVE_REINSTALL_HW_BREAKPOINT
	depends on DEBUG_FS
	depends on PRINTK
	select KPROBES
	select KRETPROBES
	select STACKTRACE
	help
	  A generalized hardware-assisted memory monitor utility.
	  It provides a low-overhead, real-time trigger mechanism to monitor
	  kernel memory safely in atomic contexts using hardware breakpoints.

	  KWatch is designed to catch silent memory corruptions, stack
	  overwrites, and complex Heisenbugs by synchronously trapping the
	  exact instruction causing the illegal access.

	  If unsure, say N.
```
